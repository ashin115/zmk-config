## boards/shields/cradio/Kconfig.defconfig
```kconfig
if SHIELD_CRADIO_DONGLE
    config ZMK_KEYBOARD_NAME
        default "Cradio"

    config ZMK_SPLIT
        default y

    config ZMK_SPLIT_ROLE_CENTRAL
        default y

    # Ferris Sweep has 2 peripherals (left + right halves)
    config ZMK_SPLIT_BLE_CENTRAL_PERIPHERALS
        default 2

    # ZMK_SPLIT_BLE_CENTRAL_PERIPHERALS + desired BT profiles (5 default) = 7
    config BT_MAX_CONN
        default 7

    config BT_MAX_PAIRED
        default 7
endif
```

## config/west.yml
```yaml
manifest:
  remotes:
    - name: zmkfirmware
      url-base: https://github.com/zmkfirmware
    - name: ashin115
      url-base: https://github.com/ashin115
  projects:
    - name: zmk
      remote: zmkfirmware
      revision: main
      import: app/west.yml
    - name: prospector-zmk-module
      remote: ashin115
      revision: feat/new-status-screens
  self:
    path: config
```
